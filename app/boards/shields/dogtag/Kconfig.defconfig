## app/boards/shields/dogtag/Kconfig.defconfig
```kconfig
# Copyright (c) 2026 The ZMK Contributors
# SPDX-License-Identifier: MIT

if SHIELD_DOGTAG

config ZMK_KEYBOARD_NAME
    default "DogTag"

endif
```

## app/boards/shields/dogtag/Kconfig.shield
```kconfig
# Copyright (c) 2026 The ZMK Contributors
# SPDX-License-Identifier: MIT

config SHIELD_DOGTAG
    def_bool $(shields_list_contains,dogtag)
```
