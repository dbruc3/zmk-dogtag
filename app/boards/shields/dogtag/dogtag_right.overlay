/*
 * Copyright (c) 2026 The ZMK Contributors
 * SPDX-License-Identifier: MIT
 */

#include "dogtag.dtsi"

&default_transform {
    col-offset = <5>;
};

&kscan0 {
    /* Reversed on the right, as in QMK. */
    col-gpios = <&pro_micro 15 GPIO_ACTIVE_HIGH>,
                <&pro_micro 18 GPIO_ACTIVE_HIGH>,
                <&pro_micro 19 GPIO_ACTIVE_HIGH>,
                <&pro_micro 20 GPIO_ACTIVE_HIGH>,
                <&pro_micro 21 GPIO_ACTIVE_HIGH>;
};
